/*
* DevDotNet.ORG <anton@devdotnet.org>
*
* MIT License
* 
* Device: DS18B20
* Module      Connector
* Control    ->  PC0
*/

/dts-v1/;
/plugin/;

/ {
	compatible = "allwinner,sun50i-a64";

	fragment@0 {
		target = <&pio>;
		__overlay__ {
			w1_custom_pins: w1_custom_pins {
				pins = "PC0";
				function = "gpio_in";
			};
		};
	};

	fragment@1 {
		target-path = "/";
		__overlay__ {
			onewire@1 {
				compatible = "w1-gpio";
				pinctrl-names = "default";
				pinctrl-0 = <&w1_custom_pins>;
				gpios = <&pio 2 0 0>; /* PC0 */
				status = "okay";
			};
		};
	};
};