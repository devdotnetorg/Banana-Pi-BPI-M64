/*
* DevDotNet.ORG <anton@devdotnet.org>
*
* MIT License
* 
* Device: Integrated blue LED
*/

/dts-v1/;
/plugin/;

/ {
	compatible = "allwinner,sun50i-a64";
	
	fragment@0 {
		target-path = "/leds/";
		__overlay__ {
			led-2 {				
				//turn off the device
				status = "disabled";			
			};
		};
	};
};