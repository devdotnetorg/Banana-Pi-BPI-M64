/*
* DevDotNet.ORG <anton@devdotnet.org>
*
* MIT License
* 
* Device: Bosch Sensortec BMP180 / banana pi m-64
* Module      Connector
* SDA		<-  PH3
* SCL		<-  PH2
*/
/dts-v1/;
/plugin/;

/ {
	compatible = "allwinner,sun50i-a64";

	fragment@0 {
		target-path = "/aliases";
		__overlay__ {
			i2c1 = "/soc/i2c@1c2b000";
		};
	};

	fragment@1 {
		target = <&i2c1>;
		__overlay__ {
			pinctrl-names = "default";
			pinctrl-0 = <&i2c1_pins>;
			status = "okay";
			
			bmp180@XX {
				compatible = "bosch,bmp180";				
				reg = <0xXX>;				
				status = "okay";				
			};
		};
	};
};